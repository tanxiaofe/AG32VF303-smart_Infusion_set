#include "ds18b20.h"

/******************************************************************************
     用法：	
      uint16_t Temp;//定义温度数值
	  判断是否接入S18B20
        if(DS18B20_Reset()==0)
		{
			Temp = DS18B20_ReadTemp();
            printf("TEMP:%d.%d\r\n",Temp/10%100,Temp%10); //打印温度
        }								整数部分  小数部分 保留1位
        else //没检测到DS18B20
        {
            printf("no sensor!\r\n");
            delay_ms(1000);
        }
******************************************************************************/


/*正负温度标志位*/
uint8_t flag=0;

/******************************************************************************
      函数说明：初始化DS18B20引脚
      入口数据：无
      返回值：  无
******************************************************************************/
void DS18B20_Init(void) 																	
{
	SYS_EnableAPBClock(TEMP_GPIO_MASK);
	GPIO_SetOutput(TEMP_GPIO, TEMP_PORT);
}

/******************************************************************************
      函数说明：DS18B20引脚设置输出模式
      入口数据：无
      返回值：  无
******************************************************************************/
void DS18B20_Output(void)      //输出模式            
{
	GPIO_SetOutput(TEMP_GPIO, TEMP_PORT);
}

/******************************************************************************
      函数说明：DS18B20引脚设置输入模式
      入口数据：无
      返回值：  无
******************************************************************************/
void DS18B20_Input(void)      //输入模式
{
	GPIO_SetInput(TEMP_GPIO, TEMP_PORT);
}

/******************************************************************************
      函数说明：复位DS18B20
      入口数据：无
      返回值：  无
******************************************************************************/
uint8_t DS18B20_Reset(void)      //复位
{
	uint8_t flag;
	DS18B20_Output();
	DQ_H;
	delay_us(5);
	DQ_L;
	delay_us(750);
	DQ_H;
	delay_us(60);
	DS18B20_Input();
	flag=DQ_Read;
	delay_us(480);
	DS18B20_Output();
	DQ_H;
	return flag;
}

/******************************************************************************
      函数说明：DS18B20写入指令
      入口数据：无
      返回值：  无
******************************************************************************/
void DS18B20_WriteData(uint8_t data)     // 写数据
{
	for(uint8_t i=0;i<8;i++)
	{
		DS18B20_Output();  //输出状态
		DQ_L;
		delay_us(2);
		if(data&0x01)     //低位开始，看上一节视频有详细讲解
		{
			DQ_H;
		}
		else
		{
			DQ_L;
		}
		delay_us(60);
		DQ_H;
		data = data>>1;
	}
	
}

/******************************************************************************
      函数说明：读取DS18B20发回数据
      入口数据：无
      返回值：  无
******************************************************************************/
uint8_t DS18B20_ReadData(void)      //读数据
{
	uint8_t data =0;
	
	for(uint8_t i=0;i<8;i++)
	{
		data=data>>1;
		DS18B20_Output();   //输出状态
		DQ_L;
		delay_us(2);
		DQ_H;
		delay_us(2);
		DS18B20_Input();   //输入状态
		if(DQ_Read)
			data|=0x80;     //放入高位，再移位到低位，看上一节视频有详细讲解
		delay_us(60);
	}
	return data;
}

/******************************************************************************
      函数说明：获取温度
      入口数据：无
      返回值：  无
******************************************************************************/
uint16_t DS18B20_ReadTemp(void)   //读取温度
{
	uint8_t DL,DH;
	uint16_t data;	
	uint16_t Temperature=0;
	flag=0;
	DS18B20_Reset();              //复位
	DS18B20_WriteData(0XCC);      //跳过ROM检测
	DS18B20_WriteData(0X44);      //启动温度转换
	delay_ms(750);                //延时，等待转换完成
	DS18B20_Reset();              //复位
	DS18B20_WriteData(0XCC);      //跳过ROM检测
	DS18B20_WriteData(0XBE);      //读取暂存器指令
	DL=DS18B20_ReadData();        //读温度低位
	DH=DS18B20_ReadData();        //读温度高位
	data=DH;
	data=data<<8;
	data|=DL;
	if((data&0XF800)==0XF800)   
	{
		data=~data+0X01;
		flag=1;
	}
		
	Temperature=data * 0.0625*10;
	return Temperature;
}


